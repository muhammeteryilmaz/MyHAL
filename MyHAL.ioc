# file: MyHAL.ioc
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Mcu.Family=STM32F4
Mcu.Name=STM32F446Z(C-E)Tx
Mcu.Package=LQFP144
NVIC.PriorityGroup=NVIC_PRIORITYGROUP_4
ProjectManager.HeapSize=0x200
ProjectManager.StackSize=0x400
ProjectManager.TargetToolchain=STM32CubeIDE
RCC.CortexFreq_Value=16000000
RCC.USBFreq_Value=96000000
RCC.VCOOutputFreq_Value=192000000
board=custom

// file: Core/Src/main.c
/* USER CODE BEGIN Header */
/**
  ******************************************************************************
  * @file           : main.c
  * @brief          : Main program body
  ******************************************************************************
  * @attention
  *
  * Copyright (c) 2026 STMicroelectronics.
  * All rights reserved.
  *
  * This software is licensed under terms that can be found in the LICENSE file
  * in the root directory of this software component.
  * If no LICENSE file comes with this software, it is provided AS-IS.
  *
  ******************************************************************************
  */
/* USER CODE END Header */
//#include "main.h"

/* USER CODE BEGIN Includes */
#include "my_hal_gpio.h"
#include "my_hal_rcc.h"
#include "my_hal_usart.h"
/* USER CODE END Includes */

/* USER CODE BEGIN PV */
uint8_t data[3] = {0x1,0x2,0x3};
/* USER CODE END PV */

//void SystemClock_Config(void);

int main(void)
{

  /* MCU Configuration--------------------------------------------------------*/

  /* Reset of all peripherals, Initializes the Flash interface and the Systick. */
  //HAL_Init();

  /* USER CODE BEGIN Init */

  RCC_Enable_Oscillator(RCC_HSI);
  //RCC_Enable_PLL();
  RCC_Select_SysClock_Source(HSI);
  RCC_APB2_USART1_Enable();

  RCC_SysTick_Init();

  GPIO_Enable();

  GPIO_Port_Configure(GPIOA_ADDR, GPIO_ALTRNT_FUNC_MODE, 9, GPIO_PUSH_PULL, GPIO_SPEED_HIGH, GPIO_NOPULL);
  //GPIO_Port_Configure(GPIOA_ADDR, GPIO_ALTRNT_FUNC_MODE, 10, GPIO_PUSH_PULL, GPIO_SPEED_HIGH, GPIO_PULLDOWN);
  GPIO_Alternate_Func_Set_Port();

  USART_TX_Enable();

  /* USER CODE END Init */

  /* Configure the system clock */
  //SystemClock_Config();

  /* Initialize all configured peripherals */

  /* Infinite loop */
  while (1)
  {

    /* USER CODE BEGIN 3 */
	  USART_DR_Load(data, sizeof(data));
	  MyHAL_Delay(1000);
  }
  /* USER CODE END 3 */
}

/*
void SystemClock_Config(void)
{
  RCC_OscInitTypeDef RCC_OscInitStruct = {0};
  RCC_ClkInitTypeDef RCC_ClkInitStruct = {0};

  * Configure the main internal regulator output voltage

  __HAL_RCC_PWR_CLK_ENABLE();
  __HAL_PWR_VOLTAGESCALING_CONFIG(PWR_REGULATOR_VOLTAGE_SCALE3);

  * Initializes the RCC Oscillators according to the specified parameters
  * in the RCC_OscInitTypeDef structure.

  RCC_OscInitStruct.OscillatorType = RCC_OSCILLATORTYPE_HSI;
  RCC_OscInitStruct.HSIState = RCC_HSI_ON;
  RCC_OscInitStruct.HSICalibrationValue = RCC_HSICALIBRATION_DEFAULT;
  RCC_OscInitStruct.PLL.PLLState = RCC_PLL_NONE;
  if (HAL_RCC_OscConfig(&RCC_OscInitStruct) != HAL_OK)
  {
    Error_Handler();
  }

  * Initializes the CPU, AHB and APB buses clocks

  RCC_ClkInitStruct.ClockType = RCC_CLOCKTYPE_HCLK|RCC_CLOCKTYPE_SYSCLK
                              |RCC_CLOCKTYPE_PCLK1|RCC_CLOCKTYPE_PCLK2;
  RCC_ClkInitStruct.SYSCLKSource = RCC_SYSCLKSOURCE_HSI;
  RCC_ClkInitStruct.AHBCLKDivider = RCC_SYSCLK_DIV1;
  RCC_ClkInitStruct.APB1CLKDivider = RCC_HCLK_DIV1;
  RCC_ClkInitStruct.APB2CLKDivider = RCC_HCLK_DIV1;

  if (HAL_RCC_ClockConfig(&RCC_ClkInitStruct, FLASH_LATENCY_0) != HAL_OK)
  {
    Error_Handler();
  }
}

 USER CODE BEGIN 4

 USER CODE END 4

*
  * @brief  This function is executed in case of error occurrence.
  * @retval None

void Error_Handler(void)
{
   USER CODE BEGIN Error_Handler_Debug
   User can add his own implementation to report the HAL error return state
  __disable_irq();
  while (1)
  {
  }
   USER CODE END Error_Handler_Debug
}
*/
